/*
 * payment_app.c
 *
 *  Created on: Dec 26, 2025
 *      Author: bhara
 */

#include "sh1106.h"
#include <stdint.h>
#include "fonts.h"
#include "application_config.h"
#include "payment_app.h"
#include "payment_data_parser.h"

const uint8_t payment_qr[] = {
    // 'QrCode_crop_45', 45x45px
    0x01, 0x90, 0xab, 0xa8, 0xf4, 0x00, 0x7d, 0xf1, 0x15, 0x3d, 0x2d, 0xf0, 0x45, 0x06, 0xda, 0x63,
    0xad, 0x10, 0x45, 0x3a, 0x94, 0x38, 0xa5, 0x10, 0x45, 0x2e, 0x40, 0x39, 0x45, 0x10, 0x7d, 0x67,
    0x37, 0x5f, 0xfd, 0xf0, 0x01, 0x55, 0x55, 0x55, 0x54, 0x00, 0xff, 0x22, 0x77, 0x15, 0x17, 0xf8,
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    0x47, 0xc8, 0x7d, 0xf5, 0xf4, 0xf0, 0x1b, 0x98, 0x01, 0x06, 0x4f, 0x28, 0xe4, 0xe8
};

#define RIGHT_X      64
#define RIGHT_W      (SH1106_WIDTH - RIGHT_X)   // 128 - 64 = 64
#define RIGHT_Y       0
#define RIGHT_H      SH1106_HEIGHT              // 64

extern SPI_HandleTypeDef hspi1;

void display_qr(void)
{
  const uint8_t qr_w = 45;
  const uint8_t qr_h = 45;

  // Center QR inside the right-half area
  const uint8_t qr_x = RIGHT_X + (RIGHT_W - qr_w) / 2;
  const uint8_t qr_y = RIGHT_Y + (RIGHT_H - qr_h) / 2;

  sh1106_clear();

  // Left side text (you can keep these fixed or also center them if you want)
  sh1106_gotoXY(4, 12);
  sh1106_puts("RAZORPAY", &Font_7x10, 1);

  sh1106_gotoXY(18, 34);
  sh1106_puts("scan", &Font_7x10, 1);

  sh1106_gotoXY(11, 46);
  sh1106_puts("to pay", &Font_7x10, 1);

  // draw a border around the QR
  sh1106_draw_rect(&hspi1, qr_x-1, qr_y-1, qr_w+1, qr_h+1, 1);

  // Draw QR bitmap (centered)
  sh1106_draw_bitmap(qr_x, qr_y, payment_qr, qr_w, qr_h, 1);

  sh1106_update_screen(&hspi1);
}

void display_payments(payment_data_t *data){
  char display_buffer[64];

  // Clear the OLED screen
  sh1106_clear();

  // Display Payment ID
  sh1106_gotoXY(0, 5);
  snprintf(display_buffer, sizeof(display_buffer), "ID: %s", data->payment_id);
  sh1106_puts(display_buffer, &Font_7x10, 1);

  // Display Amount
  sh1106_gotoXY(0, 20);
  snprintf(display_buffer, sizeof(display_buffer), "Amt: %.2f", data->amount);
  sh1106_puts(display_buffer, &Font_11x18, 1);

  // Display Status
  sh1106_gotoXY(0, 40);
  snprintf(display_buffer, sizeof(display_buffer), "Status: %s", data->status);
  sh1106_puts(display_buffer, &Font_7x10, 1);

  // Display Timestamp
  sh1106_gotoXY(0, 52);
  snprintf(display_buffer, sizeof(display_buffer), "Time: %s", data->timestamp);
  sh1106_puts(display_buffer, &Font_7x10, 1);

  // Update the OLED display
  sh1106_update_screen(&hspi1);
}

void handle_payment_info( char * topic,
                          size_t topic_length,
                          uint8_t * payload,
                          size_t payload_length ){

  // 1) Validate input
  if (topic == NULL || payload == NULL || topic_length == 0 || payload_length == 0) {
    display_qr();
    return;
  }

  // 2) Process ONLY razorpay/payments topic
  // Compare lengths first, then content
  const char *payment_topic = RAZORPAY_TOPIC;
  size_t payment_topic_len = strlen(RAZORPAY_TOPIC);

  if (topic_length != payment_topic_len ||
    strncmp(topic, payment_topic, topic_length) != 0) {

    // Not our payment topic, ignore
    return;
  }

  // 3) Parse JSON payload
  payment_data_t payment_data = { 0 };
  int8_t rc = parse_payment_data((const char *)payload, payload_length, &payment_data);

  if (rc == 0) {

    // Display on OLED
    display_payments(&payment_data);

  } else {
    // Parsing failed -> fallback screen
    LogWarn(("Payment JSON parse failed (rc=%d). Showing QR.", rc));
    display_qr();
  }
}

